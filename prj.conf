## CMakeLists.txt
```
cmake_minimum_required(VERSION 3.28.0)

# Keep generated caches inside this repository, including in restricted builds.
set(USER_CACHE_DIR "${CMAKE_CURRENT_SOURCE_DIR}/.cache/zephyr" CACHE PATH
    "Zephyr toolchain capability cache")
# Zephyr's FindCcache checks the literal string "0", rather than CMake OFF.
set(USE_CCACHE "0" CACHE STRING "Enable optional external compiler cache (0/1)")
find_package(Zephyr REQUIRED HINTS $ENV{ZEPHYR_BASE})
project(respiratory_monitor)

target_include_directories(app PRIVATE include)
option(RESPMON_PIPELINE_STRESS_TEST "Delay monitoring startup to test queue overflow in QEMU" OFF)
if(RESPMON_PIPELINE_STRESS_TEST)
    target_compile_definitions(app PRIVATE RESPMON_PIPELINE_STRESS_TEST=1)
endif()
target_sources(app PRIVATE
    src/main.cpp
    src/pipeline.cpp
    src/filter.cpp
    src/sensor_health.cpp
    src/sensor_simulator.cpp
    src/state_machine.cpp
)
```

## prj.conf
```kconfig
CONFIG_CPP=y
CONFIG_STD_CPP17=y
CONFIG_PRINTK=y
CONFIG_CPP_EXCEPTIONS=n
CONFIG_CPP_RTTI=n
CONFIG_HEAP_MEM_POOL_SIZE=0
CONFIG_MAIN_STACK_SIZE=1024
CONFIG_THREAD_NAME=y
CONFIG_ASSERT=y
CONFIG_STACK_SENTINEL=y
CONFIG_LOG=y
CONFIG_LOG_MODE_IMMEDIATE=y
CONFIG_LOG_DEFAULT_LEVEL=3
CONFIG_LOG_BACKEND_SHOW_COLOR=n
CONFIG_INIT_STACKS=y
CONFIG_THREAD_STACK_INFO=y
```

## src/main.cpp
```c
#include <zephyr/logging/log.h>
#include "respmon/pipeline.hpp"

LOG_MODULE_DECLARE(respmon);

int main()
{
    LOG_INF("Respiratory monitor starting (simulated educational data)");
    respmon::start_pipeline();
    return 0;
}
```

## src/filter.cpp
```c
#include "respmon/filter.hpp"

namespace respmon
{
    ProcessedSample Filter::process(const SensorSample &sample) noexcept
    {
        if (!sample.valid)
        {
            reset();
            return {0, 0, sample.timestamp_ms, false, sample.sequence};
        }
        history_.push(sample);
        return average();
    }

    ProcessedSample Filter::average() const noexcept
    {
        if (history_.empty())
        {
            return {};
        }
        std::int64_t pressure_sum = 0;
        std::int64_t airflow_sum = 0;
        // The bound keeps sums of int32_t values within int64_t.
        static_assert(config::filter_window_size > 0, "Filter window must be nonempty");
        static_assert(config::filter_window_size <= 2147483647U,
                      "Filter window exceeds safe int64_t accumulator bound");
        std::int64_t newest_timestamp_ms = 0;
        std::uint32_t newest_sequence = 0;
        for (std::size_t i = 0; i < history_.size(); ++i)
        {
            SensorSample previous{};
            history_.get(i, previous);
            pressure_sum += previous.pressure_pa;
            airflow_sum += previous.airflow_ml_per_min;
            newest_timestamp_ms = previous.timestamp_ms;
            newest_sequence = previous.sequence;
        }
        const auto count = static_cast<std::int64_t>(history_.size());
        return {static_cast<std::int32_t>(pressure_sum / count),
                static_cast<std::int32_t>(airflow_sum / count), newest_timestamp_ms, true,
                newest_sequence};
    }
    void Filter::reset() noexcept
    {
        history_.clear();
    }
} // namespace respmon
```

## src/pipeline.cpp
```c
#include <zephyr/kernel.h>
#include <zephyr/logging/log.h>
#include "respmon/config.hpp"
#include "respmon/filter.hpp"
#include "respmon/pipeline.hpp"
#include "respmon/pipeline_config.hpp"
#include "respmon/sensor_simulator.hpp"
#include "respmon/sensor_health.hpp"
#include "respmon/state_machine.hpp"

LOG_MODULE_REGISTER(respmon, LOG_LEVEL_INF);

namespace respmon
{
    namespace
    {
        namespace settings = pipeline_config;
        static_assert(settings::first_sample_timeout_ms > config::sample_period_ms,
                      "Initial timeout must allow one sampling period plus scheduling slack");
        // An entirely identical recovery run must be rejected before it can complete.
        static_assert(SensorHealthConfig{}.max_identical_samples < MonitorConfig{}.recovery_samples,
                      "Frozen-value detection must precede default recovery");

        struct AcquisitionStats
        {
            std::uint64_t attempts{0};
            std::uint64_t enqueued{0};
            std::uint64_t dropped{0};
            std::uint64_t missing{0};
            std::uint64_t report_drops{0};
            bool queue_full{false};
            SensorScenario scenario{SensorScenario::normal};
        };
        struct MonitoringStats
        {
            std::uint64_t processed{0};
            std::uint64_t valid{0};
            std::uint64_t invalid{0};
            std::uint64_t timeouts{0};
            std::uint64_t sequence_gaps{0};
            std::uint64_t report_drops{0};
        };
        enum class ReportSource : std::uint8_t
        {
            acquisition,
            monitoring
        };
        struct Report
        {
            ReportSource source{ReportSource::acquisition};
            bool startup{false};
            bool has_sample{false};
            std::int64_t event_ms{0};
            AcquisitionStats acquisition{};
            MonitoringStats monitoring{};
            SensorSample raw{};
            ProcessedSample filtered{};
            MonitorState previous_state{MonitorState::INITIALISING};
            StateMachineResult result{};
            FaultReason health_reason{FaultReason::none};
            bool health_changed{false};
        };
        static_assert(__is_trivially_copyable(Report), "Reports must be byte-copyable");

        K_MSGQ_DEFINE(sample_queue, sizeof(SensorSample), settings::sample_queue_capacity,
                      alignof(SensorSample));
        K_MSGQ_DEFINE(report_queue, sizeof(Report), settings::report_queue_capacity, alignof(Report));

        extern const k_tid_t acquisition_thread;
        extern const k_tid_t monitoring_thread;
        extern const k_tid_t reporting_thread;

        void publish(const Report &report, std::uint64_t &dropped) noexcept
        {
            // Best-effort diagnostics. The next successful snapshot includes any losses.
            if (k_msgq_put(&report_queue, &report, K_NO_WAIT) != 0)
            {
                ++dropped;
            }
        }

        void acquisition_entry(void *, void *, void *)
        {
            SensorSimulator sensor;
            AcquisitionStats stats;
            Report report;
            report.source = ReportSource::acquisition;
            report.startup = true;
            publish(report, stats.report_drops);
            report.startup = false;
            std::int64_t next_ms = k_uptime_get();
            while (true)
            {
                const auto now = k_uptime_get();
                const auto reading = sensor.read(now);
                ++stats.attempts;
                stats.scenario = reading.scenario;
                stats.queue_full = false;
                if (!reading.available)
                {
                    ++stats.missing;
                }
                else if (k_msgq_put(&sample_queue, &reading.sample, K_NO_WAIT) == 0)
                {
                    ++stats.enqueued;
                }
                else
                {
                    // Drop newest: retain already queued samples, never wait on monitoring.
                    ++stats.dropped;
                    stats.queue_full = true;
                }
                report.event_ms = now;
                report.acquisition = stats;
                publish(report, stats.report_drops);
                next_ms += config::sample_period_ms;
                const auto after = k_uptime_get();
                if (next_ms <= after)
                {
                    next_ms += ((after - next_ms) / config::sample_period_ms + 1) *
                               config::sample_period_ms;
                }
                k_sleep(K_TIMEOUT_ABS_MS(next_ms));
            }
        }

        void monitoring_entry(void *, void *, void *)
        {
            Filter filter;
            SensorHealth health;
            StateMachine monitor;
            MonitoringStats stats;
            Report report;
            report.source = ReportSource::monitoring;
            report.startup = true;
            publish(report, stats.report_drops);
            report.startup = false;
            FaultReason previous_health = FaultReason::none;
            auto wait_ms = settings::first_sample_timeout_ms;
#ifdef RESPMON_PIPELINE_STRESS_TEST
            // Test-only startup stall: four slots fill, then acquisition must drop
            // newest without blocking.
            k_sleep(K_MSEC(3000));
#endif
            while (true)
            {
                SensorSample raw;
                const int received = k_msgq_get(&sample_queue, &raw, K_MSEC(wait_ms));
                report.previous_state = monitor.state();
                report.event_ms = k_uptime_get();
                if (received == 0)
                {
                    ++stats.processed;
                    const auto checked = health.inspect(raw, report.event_ms);
                    stats.sequence_gaps += checked.missing_sequences;
                    report.raw = raw;
                    report.health_reason = checked.reason;
                    if (checked.accepted())
                    {
                        ++stats.valid;
                        report.filtered = filter.process(raw);
                        report.result = monitor.update(report.filtered);
                    }
                    else
                    {
                        ++stats.invalid;
                        filter.reset();
                        report.filtered = {0, 0, raw.timestamp_ms, false, raw.sequence};
                        report.result = monitor.on_sensor_fault(checked.reason);
                    }
                    report.has_sample = true;
                    wait_ms = settings::first_sample_timeout_ms;
                }
                else
                {
                    ++stats.timeouts;
                    filter.reset();
                    health.on_timeout();
                    report.result = monitor.on_timeout();
                    report.health_reason = FaultReason::sensor_timeout;
                    report.has_sample = false;
                    // After the first overdue sample, emit one timeout per expected period.
                    wait_ms = config::sample_period_ms;
                }
                report.health_changed = report.health_reason != previous_health;
                previous_health = report.health_reason;
                report.monitoring = stats;
                publish(report, stats.report_drops);
            }
        }

        void print_summary(const AcquisitionStats &acquisition, const Report &latest,
                           bool have_sample, const SensorSample &raw,
                           const ProcessedSample &filtered)
        {
            // The sample values are retained during a timeout; the validity field below
            // says whether they describe the latest monitoring event.
            LOG_INF("SUMMARY time=%lld ms acq_scenario=%s state=%s reason=%s "
                    "seq=%lu sample_time=%lld ms raw_pressure=%ld Pa filtered_pressure=%ld Pa "
                    "raw_airflow=%ld mL/min filtered_airflow=%ld mL/min "
                    "valid=%u filtered_valid=%u latest_event_sample=%u "
                    "total=%llu valid_count=%llu invalid=%llu dropped=%llu",
                    static_cast<long long>(k_uptime_get()), scenario_name(acquisition.scenario),
                    state_name(latest.result.state), fault_name(latest.result.fault_reason),
                    static_cast<unsigned long>(raw.sequence), static_cast<long long>(raw.timestamp_ms),
                    static_cast<long>(raw.pressure_pa), static_cast<long>(filtered.pressure_pa),
                    static_cast<long>(raw.airflow_ml_per_min), static_cast<long>(filtered.airflow_ml_per_min),
                    static_cast<unsigned int>(have_sample && raw.valid),
                    static_cast<unsigned int>(have_sample && latest.has_sample && filtered.valid),
                    static_cast<unsigned int>(latest.has_sample),
                    static_cast<unsigned long long>(latest.monitoring.processed),
                    static_cast<unsigned long long>(latest.monitoring.valid),
                    static_cast<unsigned long long>(latest.monitoring.invalid),
                    static_cast<unsigned long long>(acquisition.dropped));
        }

        void print_counters(const AcquisitionStats &acquisition, const Report &latest)
        {
            LOG_INF("COUNTERS time=%lld ms attempts=%llu enqueued=%llu dropped=%llu missing=%llu "
                    "total=%llu valid=%llu invalid=%llu timeouts=%llu gaps=%llu report_drops=%llu/%llu",
                    static_cast<long long>(k_uptime_get()),
                    static_cast<unsigned long long>(acquisition.attempts),
                    static_cast<unsigned long long>(acquisition.enqueued),
                    static_cast<unsigned long long>(acquisition.dropped),
                    static_cast<unsigned long long>(acquisition.missing),
                    static_cast<unsigned long long>(latest.monitoring.processed),
                    static_cast<unsigned long long>(latest.monitoring.valid),
                    static_cast<unsigned long long>(latest.monitoring.invalid),
                    static_cast<unsigned long long>(latest.monitoring.timeouts),
                    static_cast<unsigned long long>(latest.monitoring.sequence_gaps),
                    static_cast<unsigned long long>(acquisition.report_drops),
                    static_cast<unsigned long long>(latest.monitoring.report_drops));
        }

        void report_stack_usage()
        {
            std::size_t acquisition_unused = 0;
            std::size_t monitoring_unused = 0;
            std::size_t reporting_unused = 0;
            const int acquisition_rc = k_thread_stack_space_get(acquisition_thread, &acquisition_unused);
            const int monitoring_rc = k_thread_stack_space_get(monitoring_thread, &monitoring_unused);
            const int reporting_rc = k_thread_stack_space_get(reporting_thread, &reporting_unused);
            if (acquisition_rc != 0 || monitoring_rc != 0 || reporting_rc != 0 ||
                acquisition_unused > settings::acquisition_stack_bytes ||
                monitoring_unused > settings::monitoring_stack_bytes ||
                reporting_unused > settings::reporting_stack_bytes)
            {
                LOG_WRN("STACK inspection unavailable rc=%d/%d/%d unused=%zu/%zu/%zu",
                        acquisition_rc, monitoring_rc, reporting_rc,
                        acquisition_unused, monitoring_unused, reporting_unused);
                return;
            }
            LOG_INF("STACK high_water_bytes acquisition=%zu/%d monitoring=%zu/%d reporting=%zu/%d",
                    settings::acquisition_stack_bytes - acquisition_unused, settings::acquisition_stack_bytes,
                    settings::monitoring_stack_bytes - monitoring_unused, settings::monitoring_stack_bytes,
                    settings::reporting_stack_bytes - reporting_unused, settings::reporting_stack_bytes);
        }

        void reporting_entry(void *, void *, void *)
        {
            LOG_INF("THREAD reporting started priority=%d stack=%d bytes",
                    settings::reporting_priority, settings::reporting_stack_bytes);
            AcquisitionStats acquisition;
            Report latest;
            SensorSample raw;
            ProcessedSample filtered;
            bool have_sample = false;
            std::int64_t next_summary = k_uptime_get() + settings::summary_period_ms;
            std::int64_t next_stack_report = k_uptime_get() + settings::stack_report_period_ms;
            while (true)
            {
                Report report;
                const auto now = k_uptime_get();
                const auto remaining = next_summary > now ? next_summary - now : 0;
                if (k_msgq_get(&report_queue, &report, K_MSEC(remaining)) == 0)
                {
                    if (report.startup)
                    {
                        const bool is_acquisition = report.source == ReportSource::acquisition;
                        LOG_INF("THREAD %s started priority=%d stack=%d bytes",
                                is_acquisition ? "acquisition" : "monitoring",
                                is_acquisition ? settings::acquisition_priority : settings::monitoring_priority,
                                is_acquisition ? settings::acquisition_stack_bytes : settings::monitoring_stack_bytes);
                    }
                    else if (report.source == ReportSource::acquisition)
                    {
                        if (report.acquisition.queue_full && !acquisition.queue_full)
                        {
                            LOG_WRN("DROP acquisition time=%lld ms total=%llu policy=drop_newest",
                                    static_cast<long long>(report.event_ms),
                                    static_cast<unsigned long long>(report.acquisition.dropped));
                        }
                        acquisition = report.acquisition;
                    }
                    else
                    {
                        if (report.health_changed)
                        {
                            if (report.health_reason == FaultReason::none)
                            {
                                LOG_INF("HEALTH time=%lld ms reason=%s gaps=%llu",
                                        static_cast<long long>(report.event_ms), fault_name(report.health_reason),
                                        static_cast<unsigned long long>(report.monitoring.sequence_gaps));
                            }
                            else
                            {
                                LOG_WRN("HEALTH time=%lld ms reason=%s gaps=%llu",
                                        static_cast<long long>(report.event_ms), fault_name(report.health_reason),
                                        static_cast<unsigned long long>(report.monitoring.sequence_gaps));
                            }
                        }
                        if (report.result.transitioned || report.result.reason_changed)
                        {
                            if (report.result.state == MonitorState::FAULT)
                            {
                                LOG_ERR("STATE time=%lld ms from=%s to=%s reason=%s changed=%u",
                                        static_cast<long long>(report.event_ms), state_name(report.previous_state),
                                        state_name(report.result.state), fault_name(report.result.fault_reason),
                                        static_cast<unsigned int>(report.result.transitioned));
                            }
                            else if (report.result.state == MonitorState::WARNING)
                            {
                                LOG_WRN("STATE time=%lld ms from=%s to=%s reason=%s changed=%u",
                                        static_cast<long long>(report.event_ms), state_name(report.previous_state),
                                        state_name(report.result.state), fault_name(report.result.fault_reason),
                                        static_cast<unsigned int>(report.result.transitioned));
                            }
                            else
                            {
                                LOG_INF("STATE time=%lld ms from=%s to=%s reason=%s changed=%u",
                                        static_cast<long long>(report.event_ms), state_name(report.previous_state),
                                        state_name(report.result.state), fault_name(report.result.fault_reason),
                                        static_cast<unsigned int>(report.result.transitioned));
                            }
                        }
                        latest = report;
                        if (report.has_sample)
                        {
                            raw = report.raw;
                            filtered = report.filtered;
                            have_sample = true;
                        }
                    }
                }
                const auto current_ms = k_uptime_get();
                if (current_ms >= next_summary)
                {
                    print_summary(acquisition, latest, have_sample, raw, filtered);
                    next_summary = k_uptime_get() + settings::summary_period_ms;
                }
                if (current_ms >= next_stack_report)
                {
                    print_counters(acquisition, latest);
                    report_stack_usage();
                    next_stack_report = k_uptime_get() + settings::stack_report_period_ms;
                }
            }
        }

        K_THREAD_DEFINE(acquisition_thread, settings::acquisition_stack_bytes, acquisition_entry,
                        nullptr, nullptr, nullptr, settings::acquisition_priority, 0, SYS_FOREVER_MS);
        K_THREAD_DEFINE(monitoring_thread, settings::monitoring_stack_bytes, monitoring_entry,
                        nullptr, nullptr, nullptr, settings::monitoring_priority, 0, SYS_FOREVER_MS);
        K_THREAD_DEFINE(reporting_thread, settings::reporting_stack_bytes, reporting_entry,
                        nullptr, nullptr, nullptr, settings::reporting_priority, 0, SYS_FOREVER_MS);
    } // namespace

    void start_pipeline() noexcept
    {
#ifdef RESPMON_PIPELINE_STRESS_TEST
        LOG_INF("TEST queue_overflow monitoring_start_delay=3000 ms");
#endif
        LOG_INF("PIPELINE sample_queue=%d report_queue=%d period=%ld ms timeout=%ld ms",
                settings::sample_queue_capacity, settings::report_queue_capacity,
                static_cast<long>(config::sample_period_ms),
                static_cast<long>(settings::first_sample_timeout_ms));
        k_thread_start(reporting_thread);
        k_thread_start(monitoring_thread);
        k_thread_start(acquisition_thread);
    }
} // namespace respmon
```

## src/sensor_health.cpp
```c
#include "respmon/sensor_health.hpp"

namespace respmon
{
    SensorHealthResult SensorHealth::inspect(const SensorSample &sample, std::int64_t now_ms) noexcept
    {
        if (!config_.valid())
        {
            return {FaultReason::invalid_configuration, 0};
        }

        // Sequence numbers use modulo-2^32 serial arithmetic.
        FaultReason sequence_fault = FaultReason::none;
        std::uint32_t missing = 0;
        if (!have_sequence_)
        {
            missing = sample.sequence;
            if (missing != 0)
            {
                sequence_fault = FaultReason::sequence_gap;
            }
            have_sequence_ = true;
            last_sequence_ = sample.sequence;
        }
        else
        {
            const auto distance = static_cast<std::uint32_t>(sample.sequence - last_sequence_);
            if (distance == 0 || distance >= 0x80000000U)
            {
                sequence_fault = FaultReason::sequence_order;
            }
            else
            {
                missing = distance - 1U;
                if (missing != 0)
                {
                    sequence_fault = FaultReason::sequence_gap;
                }
                last_sequence_ = sample.sequence;
            }
        }

        // Test sign and ordering before subtraction to avoid signed overflow.
        const bool timestamp_ok = now_ms >= 0 && sample.timestamp_ms >= 0 &&
                                  sample.timestamp_ms <= now_ms && now_ms - sample.timestamp_ms <= config_.max_age_ms &&
                                  (!have_timestamp_ || sample.timestamp_ms > last_timestamp_ms_);
        if (timestamp_ok)
        {
            // Track fresh timestamps even for rejected payloads to reject duplicates.
            have_timestamp_ = true;
            last_timestamp_ms_ = sample.timestamp_ms;
        }

        FaultReason reason = FaultReason::none;
        if (!timestamp_ok)
        {
            reason = FaultReason::stale_timestamp;
        }
        else if (sequence_fault != FaultReason::none)
        {
            reason = sequence_fault;
        }
        else if (!sample.valid)
        {
            reason = FaultReason::invalid_sample;
        }
        else if (sample.pressure_pa < config_.min_pressure_pa ||
                 sample.pressure_pa > config_.max_pressure_pa ||
                 sample.airflow_ml_per_min < config_.min_airflow_ml_per_min ||
                 sample.airflow_ml_per_min > config_.max_airflow_ml_per_min)
        {
            reason = FaultReason::out_of_range;
        }

        if (reason != FaultReason::none)
        {
            identical_count_ = 0;
        }
        else
        {
            if (identical_count_ != 0 && sample.pressure_pa == last_pressure_ &&
                sample.airflow_ml_per_min == last_airflow_)
            {
                if (identical_count_ <= config_.max_identical_samples)
                {
                    ++identical_count_;
                }
            }
            else
            {
                identical_count_ = 1;
                last_pressure_ = sample.pressure_pa;
                last_airflow_ = sample.airflow_ml_per_min;
            }
            if (identical_count_ > config_.max_identical_samples)
            {
                reason = FaultReason::frozen_sensor;
            }
        }
        return {reason, missing};
    }
} // namespace respmon
```

## src/sensor_simulator.cpp
```c
#include "respmon/sensor_simulator.hpp"
#include "respmon/config.hpp"

namespace respmon
{
    namespace
    {
        constexpr SensorScenario schedule[] = {
            SensorScenario::normal, SensorScenario::elevated, SensorScenario::critical,
            SensorScenario::invalid, SensorScenario::out_of_range, SensorScenario::stale_timestamp,
            SensorScenario::sequence_gap, SensorScenario::frozen,
            SensorScenario::timeout, SensorScenario::recovery};
        constexpr std::uint32_t scenario_count = sizeof(schedule) / sizeof(schedule[0]);
        static_assert(config::samples_per_scenario > 0, "Scenario duration must be positive");
        static_assert(config::samples_per_scenario <= UINT32_MAX / scenario_count,
                      "Scenario schedule must fit the step counter");
        static_assert(config::waveform_steps > 0, "Waveform period must be positive");
        static_assert(static_cast<std::uint64_t>(config::waveform_steps) <=
                          static_cast<std::uint64_t>(INT32_MAX) + 1U,
                      "Waveform index must fit in int32_t");
        static_assert(static_cast<std::int64_t>(config::base_pressure_pa) + 300 +
                              config::waveform_steps - 1 <=
                          INT32_MAX,
                      "Simulated pressure must fit in int32_t");
        static_assert(static_cast<std::int64_t>(config::base_airflow_ml_per_min) + 124 <= INT32_MAX,
                      "Simulated airflow must fit in int32_t");
        constexpr auto cycle_length = scenario_count * config::samples_per_scenario;
    } // namespace

    const char *scenario_name(SensorScenario scenario) noexcept
    {
        switch (scenario)
        {
        case SensorScenario::normal:
            return "normal";
        case SensorScenario::elevated:
            return "elevated";
        case SensorScenario::critical:
            return "critical";
        case SensorScenario::invalid:
            return "invalid";
        case SensorScenario::out_of_range:
            return "out_of_range";
        case SensorScenario::stale_timestamp:
            return "stale_timestamp";
        case SensorScenario::sequence_gap:
            return "sequence_gap";
        case SensorScenario::frozen:
            return "frozen";
        case SensorScenario::timeout:
            return "timeout";
        case SensorScenario::recovery:
            return "recovery";
        }
        return "unknown";
    }

    SimulatedReading SensorSimulator::read(std::int64_t timestamp_ms) noexcept
    {
        const auto scenario = schedule[step_ / config::samples_per_scenario];
        const auto phase = step_ % config::samples_per_scenario;
        if (scenario == SensorScenario::sequence_gap)
        {
            ++sequence_;
        }
        const auto sequence = sequence_++;
        step_ = (step_ + 1U) % cycle_length;
        if (scenario == SensorScenario::timeout)
        {
            return {{}, scenario, false};
        }

        SensorSample sample{
            config::base_pressure_pa + static_cast<std::int32_t>(phase % config::waveform_steps),
            config::base_airflow_ml_per_min + static_cast<std::int32_t>(phase % 5U),
            timestamp_ms, true, sequence};
        switch (scenario)
        {
        case SensorScenario::elevated:
            sample.pressure_pa += 100;
            sample.airflow_ml_per_min += 40;
            break;
        case SensorScenario::critical:
            sample.pressure_pa += 300;
            sample.airflow_ml_per_min += 120;
            break;
        case SensorScenario::invalid:
            sample.valid = false; // Transport/sensor validity failure, nominal values.
            break;
        case SensorScenario::out_of_range:
            sample.pressure_pa = -1000;
            sample.airflow_ml_per_min = 1000000;
            // Deliberately claim valid to exercise independent range validation.
            break;
        case SensorScenario::stale_timestamp:
            sample.timestamp_ms = timestamp_ms >= 2000 ? timestamp_ms - 2000 : 0;
            break;
        case SensorScenario::frozen:
            sample.pressure_pa = config::base_pressure_pa;
            sample.airflow_ml_per_min = config::base_airflow_ml_per_min;
            break;
        default:
            break;
        }
        return {sample, scenario, true};
    }
} // namespace respmon
```

## src/state_machine.cpp
```c
#include "respmon/state_machine.hpp"

namespace respmon
{
    namespace
    {
        void increment(std::uint32_t &count, std::uint32_t limit) noexcept
        {
            // Saturate to avoid overflow on long runs.
            if (count < limit)
            {
                ++count;
            }
        }
    } // namespace

    const char *state_name(MonitorState state) noexcept
    {
        switch (state)
        {
        case MonitorState::INITIALISING:
            return "INITIALISING";
        case MonitorState::MONITORING:
            return "MONITORING";
        case MonitorState::WARNING:
            return "WARNING";
        case MonitorState::FAULT:
            return "FAULT";
        }
        return "UNKNOWN";
    }

    const char *fault_name(FaultReason reason) noexcept
    {
        switch (reason)
        {
        case FaultReason::none:
            return "none";
        case FaultReason::invalid_sample:
            return "invalid_sample";
        case FaultReason::sensor_timeout:
            return "sensor_timeout";
        case FaultReason::pressure_threshold:
            return "pressure_threshold";
        case FaultReason::airflow_threshold:
            return "airflow_threshold";
        case FaultReason::invalid_configuration:
            return "invalid_configuration";
        case FaultReason::stale_timestamp:
            return "stale_timestamp";
        case FaultReason::sequence_gap:
            return "sequence_gap";
        case FaultReason::sequence_order:
            return "sequence_order";
        case FaultReason::out_of_range:
            return "out_of_range";
        case FaultReason::frozen_sensor:
            return "frozen_sensor";
        }
        return "unknown";
    }

    StateMachineResult StateMachine::update(const ProcessedSample &sample) noexcept
    {
        if (!sample.valid)
        {
            return evaluate(true, FaultReason::invalid_sample);
        }
        if (sample.pressure_pa >= config_.fault_pressure_pa)
        {
            return evaluate(true, FaultReason::pressure_threshold);
        }
        if (sample.airflow_ml_per_min >= config_.fault_airflow_ml_per_min)
        {
            return evaluate(true, FaultReason::airflow_threshold);
        }
        return evaluate(sample.pressure_pa >= config_.warning_pressure_pa ||
                            sample.airflow_ml_per_min >= config_.warning_airflow_ml_per_min,
                        FaultReason::none);
    }

    StateMachineResult StateMachine::on_timeout() noexcept
    {
        return evaluate(true, FaultReason::sensor_timeout);
    }

    StateMachineResult StateMachine::on_sensor_fault(FaultReason reason) noexcept
    {
        if (reason == FaultReason::invalid_configuration)
        {
            const auto previous_state = state_;
            const auto previous_fault = fault_;
            state_ = MonitorState::FAULT;
            fault_ = reason;
            interrupt_streaks();
            return {state_, state_ != previous_state, fault_, fault_ != previous_fault};
        }
        return evaluate(true, reason == FaultReason::none ? FaultReason::invalid_sample : reason);
    }

    StateMachineResult StateMachine::evaluate(bool abnormal, FaultReason reason) noexcept
    {
        const auto previous_state = state_;
        const auto previous_fault = fault_;
        if (!config_.valid())
        {
            state_ = MonitorState::FAULT;
            fault_ = FaultReason::invalid_configuration;
        }
        else if (abnormal)
        {
            normal_count_ = 0;
            increment(abnormal_count_, config_.warning_samples);
            if (reason != FaultReason::none)
            {
                increment(fault_count_, config_.fault_samples);
            }
            else
            {
                fault_count_ = 0;
            }
            if (fault_count_ >= config_.fault_samples)
            {
                state_ = MonitorState::FAULT;
                fault_ = reason;
            }
            else if (state_ != MonitorState::FAULT && abnormal_count_ >= config_.warning_samples)
            {
                state_ = MonitorState::WARNING;
            }
        }
        else
        {
            abnormal_count_ = 0;
            fault_count_ = 0;
            increment(normal_count_, config_.recovery_samples);
            if (normal_count_ >= config_.recovery_samples)
            {
                state_ = MonitorState::MONITORING;
                fault_ = FaultReason::none;
            }
        }
        return {state_, state_ != previous_state, fault_, fault_ != previous_fault};
    }

    void StateMachine::reset() noexcept
    {
        state_ = MonitorState::INITIALISING;
        fault_ = FaultReason::none;
        interrupt_streaks();
    }

    void StateMachine::interrupt_streaks() noexcept
    {
        abnormal_count_ = 0;
        fault_count_ = 0;
        normal_count_ = 0;
    }
} // namespace respmon
```
